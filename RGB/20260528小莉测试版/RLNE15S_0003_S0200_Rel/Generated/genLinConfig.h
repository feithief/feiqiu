/******************************************************************************
*                                                                             *
*                _  _               ___             _                         *
*               (_)| |__   _ __    / _ \ _ __ ___  | |__    /\  /\            *
*               | || '_ \ | '__|  / /_\/| '_ ` _ \ | '_ \  / /_/ /            *
*               | || | | || |    / /_\\ | | | | | || |_) |/ __  /             *
*               |_||_| |_||_|    \____/ |_| |_| |_||_.__/ \/ /_/              *
*                                                                             *
*  ihr GmbH                                                                   *
*  Airport Boulevard B210                                                     *
*  77836 Rheinmuenster - Germany                                              *
*  http://www.ihr.de                                                          *
*  Phone +49(0) 7229-18475-0                                                  *
*  Fax   +49(0) 7229-18475-11                                                 *
*                                                                             *
******************************************************************************/
/* Generated by LDCTool 2.3.3.0      Date: 2024/7/23 */
/* Generated from LDF: d:\ihr_allen\allen\stack_support\keboda_tld4020\配置文件\keboda_atl8\clin1_ep13_20240708_f57sr2_0_e29vp2_0_e38bvp2_2_release2.ldf */
/* Generated for a clock frequency of 16 MHz */

#ifndef        GEN_LIN_CONFIG_H
#define        GEN_LIN_CONFIG_H

#include "SystemStatus.h"



#define LIN_INIT_TABLE(x) const_LIN_FRAME_CTRL_INIT ## x
/* LIN Attributes */
#define        LIN_BAUDRATE (19200u)

/* Node Attributes */

/* Generated Node: ATL8 */

#define        LIN_SLAVE  
#define        LIN_PROTOCOL_VERSION_2_0
#define        LIN_SUPPLIER_ID    ((l_u16)0) 
#define        LIN_SUPPLIER_ID_HI ((l_u8)0) 
#define        LIN_SUPPLIER_ID_LO ((l_u8)0) 
#define        LIN_FUNCTION_ID    ((l_u16)0) 
#define        LIN_FUNCTION_ID_HI ((l_u8)0) 
#define        LIN_FUNCTION_ID_LO ((l_u8)0) 
#define        LIN_VARIANT_ID     ((l_u8)254)

/* Access Macros for Node Information */
#define        l_get_current_NAD()        (g_lin_prod_id.NAD)
#define        l_set_current_NAD(x)       (g_lin_prod_id.NAD = (x))
#define        l_get_initial_NAD()        (g_lin_prod_id.Initial_NAD)
#define        l_get_SupplierID_Low()     (g_lin_prod_id.Supplier_lo)
#define        l_get_SupplierID_High()    (g_lin_prod_id.Supplier_hi)
#define        l_get_FunctionID_Low()     (g_lin_prod_id.Function_lo)
#define        l_get_FunctionID_High()    (g_lin_prod_id.Function_hi)
#define        l_get_Variant()            (g_lin_prod_id.Variant)


/* User Defined Attributes */

/* User Defined Diagnostic Attributes */

#define        LIN_DIAG_ENABLE
#define        LIN_COOKED_API
#define        LIN_TASK_CYCLE_MS       (2u)
#define        LIN_FRAME_TIMEOUT       (5u)
#define        LIN_FRAME_TIMEOUT_DELAY (1u)
#define        LIN_AUTOBAUD_TIMEOUT    (2u)

/* User Defined Node Attributes */

#define        LIN_ENABLE_ASSIGN_NAD
#define        LIN_ENABLE_ASSIGN_FRAME_ID
#define        LIN_ENABLE_RBI_RD_MSG_ID_PID

/* User Defined MCU Attributes */

/* TLE984x */

#ifndef LIN_TYPES
#define LIN_TYPES
   typedef unsigned char  l_bool;   /* Boolean Datatype */
   typedef unsigned char  l_u8;     /* 8Bit Datatype */
   typedef unsigned short l_u16;    /* 16Bit Datatype */
   typedef unsigned long  l_u32;    /* 32Bit Datatype */
   typedef unsigned short l_irqmask, l_ioctl_op;                                           /* Datatypes for special LIN functions */
   typedef unsigned short l_signal_handle, l_flag_handle, l_ifc_handle, l_schedule_handle; /* Datatypes for special LIN functions */
#endif /* end #ifndef LIN_TYPES */

#ifndef L_TRUE
   #define L_TRUE                      (1==1)
#endif /* end #ifdef L_TRUE */

#ifndef L_FALSE
   #define L_FALSE                      (1==0)
#endif /* end #ifdef L_FALSE */

#define        BRG_PRE       ((l_u8)0)
#define        BRG_VAL       ((l_u16)130)
#define        BRG_FD_SEL    ((l_u8)7)
#define        BG_SEL        ((l_u8)0)
#define        LIN_UART1
#define        AUTOBAUD_ENABLED
#define        MAX_BDREG        ((l_u16)(144u & 0x7FFu))
#define        MIN_BDREG        ((l_u16)(116u & 0x7FFu))
#define        LIN_INTERRUPT_PRIORITY  ((l_u8)3)
 
/* Generate the Signal Attributes */

#include "lin_type.h"


/* Frame Attributes */

#define        LIN_NUMBER_OF_FRAMES    ((l_u8)2)

#define        LIN_FRAME_CTRL_INIT {\
  {{(l_u8)8,(l_u8)0,(l_u8)8,(l_u8)129,(l_u8)1}},\
  {{(l_u8)36,(l_u8)0,(l_u8)100,(l_u8)128,(l_u8)8}}\
}
extern const t_Lin_Frame_Ctrl const_LIN_FRAME_CTRL_INIT [LIN_NUMBER_OF_FRAMES];

/* Notification Flag API, PID and Message ID Access for whole frames */

/* Use only with LIN 2.0 */
#define        l_get_msg_id_low_frame(x)     (g_lin_frame_ctrl[(x)].frame.msg_id.lo)
#define        l_get_msg_id_high_frame(x)    (g_lin_frame_ctrl[(x)].frame.msg_id.hi)
/* Use only with LIN 2.X */
#define        l_get_pid_frame(x)            (g_lin_frame_ctrl[(x)].frame.pid)
#define        l_set_pid_frame(x,y)          (g_lin_frame_ctrl[(x)].frame.pid = (y))
#define        l_flg_tst_frm_ATL8_FB_CLIN1()          (g_lin_frame_ctrl[0].frame.frame_type.update_flag == 1u)
#define        l_flg_clr_frm_ATL8_FB_CLIN1()          (g_lin_frame_ctrl[0].frame.frame_type.update_flag = 0u)
#define        LIN_FRAME_ATL8_FB_CLIN1()              (g_lin_frame_ctrl[0].frame.pid)
#define        LIN_CHANGE_PID_FRAME_ATL8_FB_CLIN1(x)  (g_lin_frame_ctrl[0].frame.pid = (x))
#define        LIN_FRAME_LOW_ATL8_FB_CLIN1_MSG_ID()   (g_lin_frame_ctrl[0].frame.msg_id.lo)
#define        LIN_FRAME_HIGH_ATL8_FB_CLIN1_MSG_ID()  (g_lin_frame_ctrl[0].frame.msg_id.hi)
#define        l_flg_tst_frm_CDCU_ATLCTR_CLIN1()          (g_lin_frame_ctrl[1].frame.frame_type.update_flag == 1u)
#define        l_flg_clr_frm_CDCU_ATLCTR_CLIN1()          (g_lin_frame_ctrl[1].frame.frame_type.update_flag = 0u)
#define        LIN_FRAME_CDCU_ATLCTR_CLIN1()              (g_lin_frame_ctrl[1].frame.pid)
#define        LIN_CHANGE_PID_FRAME_CDCU_ATLCTR_CLIN1(x)  (g_lin_frame_ctrl[1].frame.pid = (x))
#define        LIN_FRAME_LOW_CDCU_ATLCTR_CLIN1_MSG_ID()   (g_lin_frame_ctrl[1].frame.msg_id.lo)
#define        LIN_FRAME_HIGH_CDCU_ATLCTR_CLIN1_MSG_ID()  (g_lin_frame_ctrl[1].frame.msg_id.hi)

/* Signal Attributes */

/* Signal to Frame Mapping and Signal Update Flags */

#ifdef USE_PACKED
typedef @packed union
#else
typedef union
#endif /* end #ifdef USE_PACKED */
{
  struct
  {
    l_u16 ATL8_ROutputErr_CLIN1_f  :1;
    l_u16 ATL8_GOutput_Err_CLIN1_f  :1;
    l_u16 ATL8_Butput_Err_CLIN1_f  :1;
    l_u16 ATL8_Temp_Err_CLIN1_f  :1;
    l_u16 ATL8_Voltage_Err_CLIN1_f  :1;
    l_u16 ATL8_Lin_Err_CLIN1_f  :1;
    l_u16 res00  :2;
    l_u16 res01  :8;
  }flags;
  l_u16 reg[1];
}t_l_flags_ATL8_FB_CLIN1;

extern volatile t_l_flags_ATL8_FB_CLIN1 l_flags_ATL8_FB_CLIN1;

#ifdef USE_PACKED
typedef @packed union
#else
typedef union
#endif /* end #ifdef USE_PACKED */
{
  struct
  {
    l_u16 CDCU_SigNAD_LEDID1_CLIN1_f  :1;
    l_u16 CDCU_SigNAD_LEDID2_CLIN1_f  :1;
    l_u16 CDCU_SigEnable_ColorProtocol_CLIN1_f  :1;
    l_u16 CDCU_SigEnable_LED_CLIN1_f  :1;
    l_u16 CDCU_SigEnable_Fading_CLIN1_f  :1;
    l_u16 CDCU_Sig_FadingTime_CLIN1_f  :1;
    l_u16 CDCU_SigIntensity_CLIN1_f  :1;
    l_u16 CDCU_SigColorR_Predef_CLIN1_f  :1;
    l_u16 CDCU_SigColorG_CLIN1_f  :1;
    l_u16 CDCU_SigColorB_CLIN1_f  :1;
    l_u16 res0  :6;
  }flags;
  l_u16 reg[1];
}t_l_flags_CDCU_ATLCTR_CLIN1;

extern volatile t_l_flags_CDCU_ATLCTR_CLIN1 l_flags_CDCU_ATLCTR_CLIN1;

#ifdef USE_PACKED
typedef @packed union
#else
typedef union
#endif /* end #ifdef USE_PACKED */
{
  l_u8    frame_data[8];
  l_u8    *dataptr;
}t_l_FrmData;

#ifdef USE_PACKED
typedef @packed union
#else
typedef union
#endif /* end #ifdef USE_PACKED */
{
  l_u8    dataBytes[16];
  struct
  {
  t_l_FrmData    l_frm_ATL8_FB_CLIN1;
  t_l_FrmData    l_frm_CDCU_ATLCTR_CLIN1;
  }frames;
  t_l_FrmData    Frame[LIN_NUMBER_OF_FRAMES];
}t_l_Lin_Data;
extern t_l_Lin_Data    l_LinData;

extern const t_l_Lin_Data const_LinData;

/* Frame Access Macros */

/* Static Macros for frame access */

#define l_bytes_wr_frmATL8_FB_CLIN1(s,c,d) \
            do { l_set_byte_array(&l_LinData.Frame[0].frame_data[(s)],(c),(d)); \
                 g_lin_frame_ctrl[0].frame.frame_type.update_flag = 1u; } while(0)
#define l_bytes_rd_frmCDCU_ATLCTR_CLIN1(s,c,d) \
            do { l_get_byte_array(&l_LinData.Frame[1].frame_data[(s)],(c),(d)); } while(0)

/* Dynamic access functions for frames */
/* Defines for matching frame name to index */
#define FRAME_ATL8_FB_CLIN1     0u
#define FRAME_CDCU_ATLCTR_CLIN1     1u
/* Function prototypes */
/* Please use this function with great care as it is not prevented to read out frames prepared for transmission! */
extern l_bool l_bytes_rd_Frame (l_u8 FrameIdx, l_u8 Start, l_u8 Count, l_u8 Destination[]);
/* Please use this function with great care as it is not prevented to overwrite received data! */
extern l_bool l_bytes_wr_Frame (l_u8 FrameIdx, l_u8 Start, l_u8 Count, l_u8 Destination[]);


/* Signal Access Macros */

/* Signal Write Access for Signal ATL8_ROutputErr_CLIN1 */
#define        l_bool_wr_ATL8_ROutputErr_CLIN1(x)    do{ l_LinData.frames.l_frm_ATL8_FB_CLIN1.frame_data[0] &= (254u); \
                                                l_LinData.frames.l_frm_ATL8_FB_CLIN1.frame_data[0] |= ((l_u8)(x)); \
                                                g_lin_frame_ctrl[0].frame.frame_type.update_flag = 1u; \
                                                }while(0)

/* Signal Write Access for Signal ATL8_GOutput_Err_CLIN1 */
#define        l_bool_wr_ATL8_GOutput_Err_CLIN1(x)    do{ l_LinData.frames.l_frm_ATL8_FB_CLIN1.frame_data[0] &= (253u); \
                                                l_LinData.frames.l_frm_ATL8_FB_CLIN1.frame_data[0] |= ((l_u8)((x) << 1u)); \
                                                g_lin_frame_ctrl[0].frame.frame_type.update_flag = 1u; \
                                                }while(0)

/* Signal Write Access for Signal ATL8_Butput_Err_CLIN1 */
#define        l_bool_wr_ATL8_Butput_Err_CLIN1(x)    do{ l_LinData.frames.l_frm_ATL8_FB_CLIN1.frame_data[0] &= (251u); \
                                                l_LinData.frames.l_frm_ATL8_FB_CLIN1.frame_data[0] |= ((l_u8)((x) << 2u)); \
                                                g_lin_frame_ctrl[0].frame.frame_type.update_flag = 1u; \
                                                }while(0)

/* Signal Write Access for Signal ATL8_Temp_Err_CLIN1 */
#define        l_bool_wr_ATL8_Temp_Err_CLIN1(x)    do{ l_LinData.frames.l_frm_ATL8_FB_CLIN1.frame_data[0] &= (247u); \
                                                l_LinData.frames.l_frm_ATL8_FB_CLIN1.frame_data[0] |= ((l_u8)((x) << 3u)); \
                                                g_lin_frame_ctrl[0].frame.frame_type.update_flag = 1u; \
                                                }while(0)

/* Signal Write Access for Signal ATL8_Voltage_Err_CLIN1 */
#define        l_bool_wr_ATL8_Voltage_Err_CLIN1(x)    do{ l_LinData.frames.l_frm_ATL8_FB_CLIN1.frame_data[0] &= (239u); \
                                                l_LinData.frames.l_frm_ATL8_FB_CLIN1.frame_data[0] |= ((l_u8)((x) << 4u)); \
                                                g_lin_frame_ctrl[0].frame.frame_type.update_flag = 1u; \
                                                }while(0)

/* Signal Write Access for Signal ATL8_Lin_Err_CLIN1 */
#define        l_bool_wr_ATL8_Lin_Err_CLIN1(x)    do{ l_LinData.frames.l_frm_ATL8_FB_CLIN1.frame_data[0] &= (223u); \
                                                l_LinData.frames.l_frm_ATL8_FB_CLIN1.frame_data[0] |= ((l_u8)((x) << 5u)); \
                                                g_lin_frame_ctrl[0].frame.frame_type.update_flag = 1u; \
                                                }while(0)

/* Signal Read Access for Signal CDCU_SigNAD_LEDID1_CLIN1 */
#define        l_u8_rd_CDCU_SigNAD_LEDID1_CLIN1()      ((l_LinData.frames.l_frm_CDCU_ATLCTR_CLIN1.frame_data[0]) & 255u)
#define        l_flg_tst_CDCU_SigNAD_LEDID1_CLIN1()    (l_flags_CDCU_ATLCTR_CLIN1.flags.CDCU_SigNAD_LEDID1_CLIN1_f == 1u)
#define        l_flg_clr_CDCU_SigNAD_LEDID1_CLIN1()    (l_flags_CDCU_ATLCTR_CLIN1.flags.CDCU_SigNAD_LEDID1_CLIN1_f = 0u)

/* Signal Read Access for Signal CDCU_SigNAD_LEDID2_CLIN1 */
#define        l_u8_rd_CDCU_SigNAD_LEDID2_CLIN1()      ((l_LinData.frames.l_frm_CDCU_ATLCTR_CLIN1.frame_data[1]) & 255u)
#define        l_flg_tst_CDCU_SigNAD_LEDID2_CLIN1()    (l_flags_CDCU_ATLCTR_CLIN1.flags.CDCU_SigNAD_LEDID2_CLIN1_f == 1u)
#define        l_flg_clr_CDCU_SigNAD_LEDID2_CLIN1()    (l_flags_CDCU_ATLCTR_CLIN1.flags.CDCU_SigNAD_LEDID2_CLIN1_f = 0u)

/* Signal Read Access for Signal u8_CdcuSigEnableColorProtocol */
#define        l_bool_rd_CDCU_SigEnable_ColorProtocol_CLIN1()    ((l_LinData.frames.l_frm_CDCU_ATLCTR_CLIN1.frame_data[2]) & 1u)
#define        l_flg_tst_CDCU_SigEnable_ColorProtocol_CLIN1()    (l_flags_CDCU_ATLCTR_CLIN1.flags.CDCU_SigEnable_ColorProtocol_CLIN1_f == 1u)
#define        l_flg_clr_CDCU_SigEnable_ColorProtocol_CLIN1()    (l_flags_CDCU_ATLCTR_CLIN1.flags.CDCU_SigEnable_ColorProtocol_CLIN1_f = 0u)

/* Signal Read Access for Signal u8_CdcuSigEnableLed */
#define        l_bool_rd_CDCU_SigEnable_LED_CLIN1()    ((l_LinData.frames.l_frm_CDCU_ATLCTR_CLIN1.frame_data[2] >> 1u) & 1u)
#define        l_flg_tst_CDCU_SigEnable_LED_CLIN1()    (l_flags_CDCU_ATLCTR_CLIN1.flags.CDCU_SigEnable_LED_CLIN1_f == 1u)
#define        l_flg_clr_CDCU_SigEnable_LED_CLIN1()    (l_flags_CDCU_ATLCTR_CLIN1.flags.CDCU_SigEnable_LED_CLIN1_f = 0u)

/* Signal Read Access for Signal u8_CdcuSigEnableFading */
#define        l_bool_rd_CDCU_SigEnable_Fading_CLIN1()    ((l_LinData.frames.l_frm_CDCU_ATLCTR_CLIN1.frame_data[2] >> 2u) & 1u)
#define        l_flg_tst_CDCU_SigEnable_Fading_CLIN1()    (l_flags_CDCU_ATLCTR_CLIN1.flags.CDCU_SigEnable_Fading_CLIN1_f == 1u)
#define        l_flg_clr_CDCU_SigEnable_Fading_CLIN1()    (l_flags_CDCU_ATLCTR_CLIN1.flags.CDCU_SigEnable_Fading_CLIN1_f = 0u)

/* Signal Read Access for Signal CDCU_Sig_FadingTime_CLIN1 */
#define        l_u8_rd_CDCU_Sig_FadingTime_CLIN1()      ((l_LinData.frames.l_frm_CDCU_ATLCTR_CLIN1.frame_data[3]) & 255u)
#define        l_flg_tst_CDCU_Sig_FadingTime_CLIN1()    (l_flags_CDCU_ATLCTR_CLIN1.flags.CDCU_Sig_FadingTime_CLIN1_f == 1u)
#define        l_flg_clr_CDCU_Sig_FadingTime_CLIN1()    (l_flags_CDCU_ATLCTR_CLIN1.flags.CDCU_Sig_FadingTime_CLIN1_f = 0u)

/* Signal Read Access for Signal CDCU_SigIntensity_CLIN1 */
#define        l_u8_rd_CDCU_SigIntensity_CLIN1()      ((l_LinData.frames.l_frm_CDCU_ATLCTR_CLIN1.frame_data[4]) & 255u)
#define        l_flg_tst_CDCU_SigIntensity_CLIN1()    (l_flags_CDCU_ATLCTR_CLIN1.flags.CDCU_SigIntensity_CLIN1_f == 1u)
#define        l_flg_clr_CDCU_SigIntensity_CLIN1()    (l_flags_CDCU_ATLCTR_CLIN1.flags.CDCU_SigIntensity_CLIN1_f = 0u)

/* Signal Read Access for Signal CDCU_SigColorR_Predef_CLIN1 */
#define        l_u8_rd_CDCU_SigColorR_Predef_CLIN1()      ((l_LinData.frames.l_frm_CDCU_ATLCTR_CLIN1.frame_data[5]) & 255u)
#define        l_flg_tst_CDCU_SigColorR_Predef_CLIN1()    (l_flags_CDCU_ATLCTR_CLIN1.flags.CDCU_SigColorR_Predef_CLIN1_f == 1u)
#define        l_flg_clr_CDCU_SigColorR_Predef_CLIN1()    (l_flags_CDCU_ATLCTR_CLIN1.flags.CDCU_SigColorR_Predef_CLIN1_f = 0u)

/* Signal Read Access for Signal CDCU_SigColorG_CLIN1 */
#define        l_u8_rd_CDCU_SigColorG_CLIN1()      ((l_LinData.frames.l_frm_CDCU_ATLCTR_CLIN1.frame_data[6]) & 255u)
#define        l_flg_tst_CDCU_SigColorG_CLIN1()    (l_flags_CDCU_ATLCTR_CLIN1.flags.CDCU_SigColorG_CLIN1_f == 1u)
#define        l_flg_clr_CDCU_SigColorG_CLIN1()    (l_flags_CDCU_ATLCTR_CLIN1.flags.CDCU_SigColorG_CLIN1_f = 0u)

/* Signal Read Access for Signal CDCU_SigColorB_CLIN1 */
#define        l_u8_rd_CDCU_SigColorB_CLIN1()      ((l_LinData.frames.l_frm_CDCU_ATLCTR_CLIN1.frame_data[7]) & 255u)
#define        l_flg_tst_CDCU_SigColorB_CLIN1()    (l_flags_CDCU_ATLCTR_CLIN1.flags.CDCU_SigColorB_CLIN1_f == 1u)
#define        l_flg_clr_CDCU_SigColorB_CLIN1()    (l_flags_CDCU_ATLCTR_CLIN1.flags.CDCU_SigColorB_CLIN1_f = 0u)

/* LIN Driver Access to Update Signal Flags for Frame ATL8_FB_CLIN1 */
#define        l_Update_flags_frame0()    (l_flags_ATL8_FB_CLIN1.reg[0]=(l_u16)0xFFFFu)

/* LIN Driver Access to Update Signal Flags for Frame CDCU_ATLCTR_CLIN1 */
#define        l_Update_flags_frame1()    (l_flags_CDCU_ATLCTR_CLIN1.reg[0]=(l_u16)0xFFFFu)

#define        l_Update_flags_frame(x)    (l_Update_Frame_Flags((x))) 

void l_Update_Frame_Flags(l_u8 number);


/* Prototype for Byte Array Signal Access Function  */
void l_get_byte_array(l_u8 start[], l_u8  count, l_u8 destination[]);
void l_set_byte_array(l_u8 start[], l_u8  count, const l_u8 source[]);

/* Macros for Response Error Flag / Frame handling */

#define        l_Set_Response_Error_Flag()   do{ l_bool_wr_ATL8_Lin_Err_CLIN1(1u); } while(0)

#define        l_Reset_Response_Error_Flag() do{ l_bool_wr_ATL8_Lin_Err_CLIN1(0u); } while(0)

#define        LIN_Response_Error_Frame_PID  (g_lin_frame_ctrl[0].frame.pid)
#define        LIN_RespError_Compare_PID(x)  ((g_lin_frame_ctrl[0].frame.pid) == (x))


extern unsigned char g_u8_SlaveNodeNAD;
extern const t_Lin_Frame_Ctrl LIN_INIT_TABLE(01) [LIN_NUMBER_OF_FRAMES];
extern const t_Lin_Frame_Ctrl LIN_INIT_TABLE(02) [LIN_NUMBER_OF_FRAMES];
extern const t_Lin_Frame_Ctrl LIN_INIT_TABLE(03) [LIN_NUMBER_OF_FRAMES];
extern const t_Lin_Frame_Ctrl LIN_INIT_TABLE(04) [LIN_NUMBER_OF_FRAMES];
extern const t_Lin_Frame_Ctrl LIN_INIT_TABLE(05) [LIN_NUMBER_OF_FRAMES];
extern const t_Lin_Frame_Ctrl LIN_INIT_TABLE(06) [LIN_NUMBER_OF_FRAMES];
extern const t_Lin_Frame_Ctrl LIN_INIT_TABLE(07) [LIN_NUMBER_OF_FRAMES];
extern const t_Lin_Frame_Ctrl LIN_INIT_TABLE(08) [LIN_NUMBER_OF_FRAMES];
extern const t_Lin_Frame_Ctrl LIN_INIT_TABLE(09) [LIN_NUMBER_OF_FRAMES];
extern const t_Lin_Frame_Ctrl LIN_INIT_TABLE(10) [LIN_NUMBER_OF_FRAMES];
extern const t_Lin_Frame_Ctrl LIN_INIT_TABLE(12) [LIN_NUMBER_OF_FRAMES];
extern const t_Lin_Frame_Ctrl LIN_INIT_TABLE(17) [LIN_NUMBER_OF_FRAMES];
extern const t_Lin_Frame_Ctrl LIN_INIT_TABLE(18) [LIN_NUMBER_OF_FRAMES];
extern const t_Lin_Frame_Ctrl LIN_INIT_TABLE(19) [LIN_NUMBER_OF_FRAMES];
extern const t_Lin_Frame_Ctrl LIN_INIT_TABLE(33) [LIN_NUMBER_OF_FRAMES];


/* File Footer */
#endif /* end #ifndef GEN_LIN_CONFIG_H */

/* genLinConfig.h file for ARISU-SRM */
