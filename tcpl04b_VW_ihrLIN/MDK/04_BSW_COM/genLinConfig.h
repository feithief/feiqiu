/******************************************************************************
*                                                                             *
*                _  _               ___             _                         *
*               (_)| |__   _ __    / _ \ _ __ ___  | |__    /\  /\            *
*               | || '_ \ | '__|  / /_\/| '_ ` _ \ | '_ \  / /_/ /            *
*               | || | | || |    / /_\\ | | | | | || |_) |/ __  /             *
*               |_||_| |_||_|    \____/ |_| |_| |_||_.__/ \/ /_/              *
*                                                                             *
*  ihr GmbH                                                                   *
*  Airport Boulevard B210                                                     *
*  77836 Rheinmuenster - Germany                                              *
*  http://www.ihr.de                                                          *
*  Phone +49(0) 7229-18475-0                                                  *
*  Fax   +49(0) 7229-18475-11                                                 *
*                                                                             *
******************************************************************************/
/* Generated by LDCTool 2.3.3.0      Date: 2024/4/22 */
/* Generated from LDF: d:\ihr_allen\allen\stack_support\keboda_tld4020\配置文件\keboda_newldf\mqb2020.mqb_w_bcm_lin5_kmatrix_v9.07f_20190529_tr.ldf */
/* Generated for a clock frequency of 40 MHz */

#ifndef        GEN_LIN_CONFIG_H
#define        GEN_LIN_CONFIG_H
 

/* LIN Attributes */
#define        LIN_BAUDRATE (19200u)

/* Node Attributes */

/* Generated Node: AM_RGB_Slave_08a */

#define        LIN_SLAVE  
#define        LIN_PROTOCOL_VERSION_2_0
#define        LIN_SUPPLIER_ID    ((l_u16)0) 
#define        LIN_SUPPLIER_ID_HI ((l_u8)0) 
#define        LIN_SUPPLIER_ID_LO ((l_u8)0) 
#define        LIN_FUNCTION_ID    ((l_u16)0) 
#define        LIN_FUNCTION_ID_HI ((l_u8)0) 
#define        LIN_FUNCTION_ID_LO ((l_u8)0) 
#define        LIN_VARIANT_ID     ((l_u8)0)

/* Access Macros for Node Information */
#define        l_get_current_NAD()        (g_lin_prod_id.NAD)
#define        l_set_current_NAD(x)       (g_lin_prod_id.NAD = (x))
#define        l_get_initial_NAD()        (g_lin_prod_id.Initial_NAD)
#define        l_get_SupplierID_Low()     (g_lin_prod_id.Supplier_lo)
#define        l_get_SupplierID_High()    (g_lin_prod_id.Supplier_hi)
#define        l_get_FunctionID_Low()     (g_lin_prod_id.Function_lo)
#define        l_get_FunctionID_High()    (g_lin_prod_id.Function_hi)
#define        l_get_Variant()            (g_lin_prod_id.Variant)


/* User Defined Attributes */

/* User Defined Diagnostic Attributes */

#define        LIN_DIAG_ENABLE
#define        LIN_COOKED_API
#define        LIN_TASK_CYCLE_MS       (2u)
#define        LIN_FRAME_TIMEOUT       (5u)
#define        LIN_FRAME_TIMEOUT_DELAY (1u)
#define        LIN_AUTOBAUD_TIMEOUT    (2u)

/* User Defined Node Attributes */
//#define        LIN_ENABLE_ASSIGN_FRAME_ID_RANGE

#define        LIN_ENABLE_ASSIGN_NAD
#define        LIN_ENABLE_ASSIGN_FRAME_ID
#define        LIN_ENABLE_RBI_RD_MSG_ID_PID

/* User Defined MCU Attributes */

/* TLE984x */

#ifndef LIN_TYPES
#define LIN_TYPES
   typedef unsigned char  l_bool;   /* Boolean Datatype */
   typedef unsigned char  l_u8;     /* 8Bit Datatype */
   typedef unsigned short l_u16;    /* 16Bit Datatype */
   typedef unsigned long  l_u32;    /* 32Bit Datatype */
   typedef unsigned short l_irqmask, l_ioctl_op;                                           /* Datatypes for special LIN functions */
   typedef unsigned short l_signal_handle, l_flag_handle, l_ifc_handle, l_schedule_handle; /* Datatypes for special LIN functions */
#endif /* end #ifndef LIN_TYPES */

#ifndef L_TRUE
   #define L_TRUE                      (1==1)
#endif /* end #ifdef L_TRUE */

#ifndef L_FALSE
   #define L_FALSE                      (1==0)
#endif /* end #ifdef L_FALSE */

#define        BRG_PRE       ((l_u8)0)
#define        BRG_VAL       ((l_u16)130)
#define        BRG_FD_SEL    ((l_u8)7)
#define        BG_SEL        ((l_u8)0)
#define        LIN_UART1
#define        AUTOBAUD_ENABLED
#define        MAX_BDREG        ((l_u16)(144u & 0x7FFu))
#define        MIN_BDREG        ((l_u16)(116u & 0x7FFu))
#define        LIN_INTERRUPT_PRIORITY  ((l_u8)3)
 
/* Generate the Signal Attributes */

#include "lin_type.h"


/* Frame Attributes */

#define        LIN_NUMBER_OF_FRAMES    ((l_u8)2)

#define        LIN_FRAME_CTRL_INIT {\
  {{(l_u8)21,(l_u8)64,(l_u8)85,(l_u8)128,(l_u8)8}},\
  {{(l_u8)8,(l_u8)64,(l_u8)8,(l_u8)129,(l_u8)8}}\
}
extern const t_Lin_Frame_Ctrl const_LIN_FRAME_CTRL_INIT [LIN_NUMBER_OF_FRAMES];

/* Notification Flag API, PID and Message ID Access for whole frames */

/* Use only with LIN 2.0 */
#define        l_get_msg_id_low_frame(x)     (g_lin_frame_ctrl[(x)].frame.msg_id.lo)
#define        l_get_msg_id_high_frame(x)    (g_lin_frame_ctrl[(x)].frame.msg_id.hi)
/* Use only with LIN 2.X */
#define        l_get_pid_frame(x)            (g_lin_frame_ctrl[(x)].frame.pid)
#define        l_set_pid_frame(x,y)          (g_lin_frame_ctrl[(x)].frame.pid = (y))
#define        l_flg_tst_frm_RGBe_Slave_a()          (g_lin_frame_ctrl[0].frame.frame_type.update_flag == 1u)
#define        l_flg_clr_frm_RGBe_Slave_a()          (g_lin_frame_ctrl[0].frame.frame_type.update_flag = 0u)
#define        LIN_FRAME_RGBe_Slave_a()              (g_lin_frame_ctrl[0].frame.pid)
#define        LIN_CHANGE_PID_FRAME_RGBe_Slave_a(x)  (g_lin_frame_ctrl[0].frame.pid = (x))
#define        LIN_FRAME_LOW_RGBe_Slave_a_MSG_ID()   (g_lin_frame_ctrl[0].frame.msg_id.lo)
#define        LIN_FRAME_HIGH_RGBe_Slave_a_MSG_ID()  (g_lin_frame_ctrl[0].frame.msg_id.hi)
#define        l_flg_tst_frm_RGBs_Slave_08a()          (g_lin_frame_ctrl[1].frame.frame_type.update_flag == 1u)
#define        l_flg_clr_frm_RGBs_Slave_08a()          (g_lin_frame_ctrl[1].frame.frame_type.update_flag = 0u)
#define        LIN_FRAME_RGBs_Slave_08a()              (g_lin_frame_ctrl[1].frame.pid)
#define        LIN_CHANGE_PID_FRAME_RGBs_Slave_08a(x)  (g_lin_frame_ctrl[1].frame.pid = (x))
#define        LIN_FRAME_LOW_RGBs_Slave_08a_MSG_ID()   (g_lin_frame_ctrl[1].frame.msg_id.lo)
#define        LIN_FRAME_HIGH_RGBs_Slave_08a_MSG_ID()  (g_lin_frame_ctrl[1].frame.msg_id.hi)

/* Signal Attributes */

/* Signal to Frame Mapping and Signal Update Flags */

#ifdef USE_PACKED
typedef @packed union
#else
typedef union
#endif /* end #ifdef USE_PACKED */
{
  struct
  {
    l_u16 BCM_RGBa_Slave_Adresse_f  :1;
    l_u16 BCM_RGBa_Adressierungsart_f  :1;
    l_u16 BCM_RGBa_Rot_f  :1;
    l_u16 BCM_RGBa_Gruen_f  :1;
    l_u16 BCM_RGBa_Blau_f  :1;
    l_u16 BCM_RGBa_Intensitaet_f  :1;
    l_u16 BCM_RGBa_Normierung_Intensitaet_f  :1;
    l_u16 BCM_RGBa_Dimmrampe_f  :1;
    l_u16 BCM_RGBa_Sonderfunktion_f  :1;
    l_u16 BCM_RGBa_Bewertung_Dimmzeit_f  :1;
    l_u16 BCM_RGBa_Gueltigkeit_f  :1;
    l_u16 BCM_RGBa_Dimmzeit_Zeitbasis_f  :1;
    l_u16 res0  :4;
  }flags;
  l_u16 reg[1];
}t_l_flags_RGBe_Slave_a;

extern volatile t_l_flags_RGBe_Slave_a l_flags_RGBe_Slave_a;

#ifdef USE_PACKED
typedef @packed union
#else
typedef union
#endif /* end #ifdef USE_PACKED */
{
  struct
  {
    l_u16 RGB_Slave_08a_ResponseError_f  :1;
    l_u16 RGB_Slave_08a_LedRotStg_f  :1;
    l_u16 RGB_Slave_08a_LedGruenStg_f  :1;
    l_u16 RGB_Slave_08a_LedBlauStg_f  :1;
    l_u16 RGB_Slave_08a_LedRotOl_f  :1;
    l_u16 RGB_Slave_08a_LedGruenOl_f  :1;
    l_u16 RGB_Slave_08a_LedBlauOl_f  :1;
    l_u16 RGB_Slave_08a_TempState_f  :1;
    l_u16 RGB_Slave_08a_IntErrorRam_f  :1;
    l_u16 RGB_Slave_08a_IntErrorRom_f  :1;
    l_u16 RGB_Slave_08a_IntErrorNvm_f  :1;
    l_u16 res0  :5;
  }flags;
  l_u16 reg[1];
}t_l_flags_RGBs_Slave_08a;

extern volatile t_l_flags_RGBs_Slave_08a l_flags_RGBs_Slave_08a;

#ifdef USE_PACKED
typedef @packed union
#else
typedef union
#endif /* end #ifdef USE_PACKED */
{
  l_u8    frame_data[8];
  l_u8    *dataptr;
}t_l_FrmData;

#ifdef USE_PACKED
typedef @packed union
#else
typedef union
#endif /* end #ifdef USE_PACKED */
{
  l_u8    dataBytes[16];
  struct
  {
  t_l_FrmData    l_frm_RGBe_Slave_a;
  t_l_FrmData    l_frm_RGBs_Slave_08a;
  }frames;
  t_l_FrmData    Frame[LIN_NUMBER_OF_FRAMES];
}t_l_Lin_Data;
extern t_l_Lin_Data    l_LinData;

extern const t_l_Lin_Data const_LinData;


extern volatile t_l_flags_RGBs_Slave_08a l_flags_RGBs_Slave_08a;
extern unsigned char SlaveNodeNAD;
extern const t_Lin_Frame_Ctrl const_LIN_FRAME_CTRL_INIT01 [LIN_NUMBER_OF_FRAMES];
extern const t_Lin_Frame_Ctrl const_LIN_FRAME_CTRL_INIT02 [LIN_NUMBER_OF_FRAMES];
extern const t_Lin_Frame_Ctrl const_LIN_FRAME_CTRL_INIT03 [LIN_NUMBER_OF_FRAMES];
extern const t_Lin_Frame_Ctrl const_LIN_FRAME_CTRL_INIT04 [LIN_NUMBER_OF_FRAMES];
extern const t_Lin_Frame_Ctrl const_LIN_FRAME_CTRL_INIT05 [LIN_NUMBER_OF_FRAMES];
extern const t_Lin_Frame_Ctrl const_LIN_FRAME_CTRL_INIT06 [LIN_NUMBER_OF_FRAMES];
extern const t_Lin_Frame_Ctrl const_LIN_FRAME_CTRL_INIT07 [LIN_NUMBER_OF_FRAMES];
extern const t_Lin_Frame_Ctrl const_LIN_FRAME_CTRL_INIT08 [LIN_NUMBER_OF_FRAMES];
extern const t_Lin_Frame_Ctrl const_LIN_FRAME_CTRL_INIT09 [LIN_NUMBER_OF_FRAMES];
extern const t_Lin_Frame_Ctrl const_LIN_FRAME_CTRL_INIT10 [LIN_NUMBER_OF_FRAMES];
extern const t_Lin_Frame_Ctrl const_LIN_FRAME_CTRL_INIT11 [LIN_NUMBER_OF_FRAMES];
extern const t_Lin_Frame_Ctrl const_LIN_FRAME_CTRL_INIT12 [LIN_NUMBER_OF_FRAMES];
extern const t_Lin_Frame_Ctrl const_LIN_FRAME_CTRL_INIT13 [LIN_NUMBER_OF_FRAMES];
extern const t_Lin_Frame_Ctrl const_LIN_FRAME_CTRL_INIT14 [LIN_NUMBER_OF_FRAMES];
extern const t_Lin_Frame_Ctrl const_LIN_FRAME_CTRL_INIT15 [LIN_NUMBER_OF_FRAMES];
extern const t_Lin_Frame_Ctrl const_LIN_FRAME_CTRL_INIT16 [LIN_NUMBER_OF_FRAMES];
extern const t_Lin_Frame_Ctrl const_LIN_FRAME_CTRL_INIT17 [LIN_NUMBER_OF_FRAMES];
extern const t_Lin_Frame_Ctrl const_LIN_FRAME_CTRL_INIT18 [LIN_NUMBER_OF_FRAMES];
extern const t_Lin_Frame_Ctrl const_LIN_FRAME_CTRL_INIT19 [LIN_NUMBER_OF_FRAMES];
extern const t_Lin_Frame_Ctrl const_LIN_FRAME_CTRL_INIT20 [LIN_NUMBER_OF_FRAMES];


/* Frame Access Macros */

/* Static Macros for frame access */

#define l_bytes_rd_frmRGBe_Slave_a(s,c,d) \
            do { l_get_byte_array(&l_LinData.Frame[0].frame_data[(s)],(c),(d)); } while(0)
#define l_bytes_wr_frmRGBs_Slave_08a(s,c,d) \
            do { l_set_byte_array(&l_LinData.Frame[1].frame_data[(s)],(c),(d)); \
                 g_lin_frame_ctrl[1].frame.frame_type.update_flag = 1u; } while(0)

/* Dynamic access functions for frames */
/* Defines for matching frame name to index */
#define FRAME_RGBe_Slave_a     0u
#define FRAME_RGBs_Slave_08a     1u
/* Function prototypes */
/* Please use this function with great care as it is not prevented to read out frames prepared for transmission! */
extern l_bool l_bytes_rd_Frame (l_u8 FrameIdx, l_u8 Start, l_u8 Count, l_u8 Destination[]);
/* Please use this function with great care as it is not prevented to overwrite received data! */
extern l_bool l_bytes_wr_Frame (l_u8 FrameIdx, l_u8 Start, l_u8 Count, l_u8 Destination[]);


/* Signal Access Macros */

/* Signal Read Access for Signal BCM_RGBa_Slave_Adresse */
#define        l_u16_rd_BCM_RGBa_Slave_Adresse()    ((((l_u16)l_LinData.frames.l_frm_RGBe_Slave_a.frame_data[0]) & 255u) | \
                                    ((l_u16)((((l_u16)l_LinData.frames.l_frm_RGBe_Slave_a.frame_data[1]) & (127u)) << 8u)))
#define        l_flg_tst_BCM_RGBa_Slave_Adresse()    (l_flags_RGBe_Slave_a.flags.BCM_RGBa_Slave_Adresse_f == 1u)
#define        l_flg_clr_BCM_RGBa_Slave_Adresse()    (l_flags_RGBe_Slave_a.flags.BCM_RGBa_Slave_Adresse_f = 0u)

/* Signal Read Access for Signal BCM_RGBa_Adressierungsart */
#define        l_bool_rd_BCM_RGBa_Adressierungsart()    ((l_LinData.frames.l_frm_RGBe_Slave_a.frame_data[1] >> 7u) & 1u)
#define        l_flg_tst_BCM_RGBa_Adressierungsart()    (l_flags_RGBe_Slave_a.flags.BCM_RGBa_Adressierungsart_f == 1u)
#define        l_flg_clr_BCM_RGBa_Adressierungsart()    (l_flags_RGBe_Slave_a.flags.BCM_RGBa_Adressierungsart_f = 0u)

/* Signal Read Access for Signal BCM_RGBa_Rot */
#define        l_u8_rd_BCM_RGBa_Rot()      ((l_LinData.frames.l_frm_RGBe_Slave_a.frame_data[2]) & 255u)
#define        l_flg_tst_BCM_RGBa_Rot()    (l_flags_RGBe_Slave_a.flags.BCM_RGBa_Rot_f == 1u)
#define        l_flg_clr_BCM_RGBa_Rot()    (l_flags_RGBe_Slave_a.flags.BCM_RGBa_Rot_f = 0u)

/* Signal Read Access for Signal BCM_RGBa_Gruen */
#define        l_u8_rd_BCM_RGBa_Gruen()      ((l_LinData.frames.l_frm_RGBe_Slave_a.frame_data[3]) & 255u)
#define        l_flg_tst_BCM_RGBa_Gruen()    (l_flags_RGBe_Slave_a.flags.BCM_RGBa_Gruen_f == 1u)
#define        l_flg_clr_BCM_RGBa_Gruen()    (l_flags_RGBe_Slave_a.flags.BCM_RGBa_Gruen_f = 0u)

/* Signal Read Access for Signal BCM_RGBa_Blau */
#define        l_u8_rd_BCM_RGBa_Blau()      ((l_LinData.frames.l_frm_RGBe_Slave_a.frame_data[4]) & 255u)
#define        l_flg_tst_BCM_RGBa_Blau()    (l_flags_RGBe_Slave_a.flags.BCM_RGBa_Blau_f == 1u)
#define        l_flg_clr_BCM_RGBa_Blau()    (l_flags_RGBe_Slave_a.flags.BCM_RGBa_Blau_f = 0u)

/* Signal Read Access for Signal BCM_RGBa_Intensitaet */
#define        l_u8_rd_BCM_RGBa_Intensitaet()      ((l_LinData.frames.l_frm_RGBe_Slave_a.frame_data[5]) & 127u)
#define        l_flg_tst_BCM_RGBa_Intensitaet()    (l_flags_RGBe_Slave_a.flags.BCM_RGBa_Intensitaet_f == 1u)
#define        l_flg_clr_BCM_RGBa_Intensitaet()    (l_flags_RGBe_Slave_a.flags.BCM_RGBa_Intensitaet_f = 0u)

/* Signal Read Access for Signal BCM_RGBa_Normierung_Intensitaet */
#define        l_bool_rd_BCM_RGBa_Normierung_Intensitaet()    ((l_LinData.frames.l_frm_RGBe_Slave_a.frame_data[5] >> 7u) & 1u)
#define        l_flg_tst_BCM_RGBa_Normierung_Intensitaet()    (l_flags_RGBe_Slave_a.flags.BCM_RGBa_Normierung_Intensitaet_f == 1u)
#define        l_flg_clr_BCM_RGBa_Normierung_Intensitaet()    (l_flags_RGBe_Slave_a.flags.BCM_RGBa_Normierung_Intensitaet_f = 0u)

/* Signal Read Access for Signal BCM_RGBa_Dimmrampe */
#define        l_u8_rd_BCM_RGBa_Dimmrampe()      ((l_LinData.frames.l_frm_RGBe_Slave_a.frame_data[6]) & 15u)
#define        l_flg_tst_BCM_RGBa_Dimmrampe()    (l_flags_RGBe_Slave_a.flags.BCM_RGBa_Dimmrampe_f == 1u)
#define        l_flg_clr_BCM_RGBa_Dimmrampe()    (l_flags_RGBe_Slave_a.flags.BCM_RGBa_Dimmrampe_f = 0u)

/* Signal Read Access for Signal BCM_RGBa_Sonderfunktion */
#define        l_u8_rd_BCM_RGBa_Sonderfunktion()      ((l_LinData.frames.l_frm_RGBe_Slave_a.frame_data[6] >> 5u) & 7u)
#define        l_flg_tst_BCM_RGBa_Sonderfunktion()    (l_flags_RGBe_Slave_a.flags.BCM_RGBa_Sonderfunktion_f == 1u)
#define        l_flg_clr_BCM_RGBa_Sonderfunktion()    (l_flags_RGBe_Slave_a.flags.BCM_RGBa_Sonderfunktion_f = 0u)

/* Signal Read Access for Signal BCM_RGBa_Bewertung_Dimmzeit */
#define        l_bool_rd_BCM_RGBa_Bewertung_Dimmzeit()    ((l_LinData.frames.l_frm_RGBe_Slave_a.frame_data[7]) & 1u)
#define        l_flg_tst_BCM_RGBa_Bewertung_Dimmzeit()    (l_flags_RGBe_Slave_a.flags.BCM_RGBa_Bewertung_Dimmzeit_f == 1u)
#define        l_flg_clr_BCM_RGBa_Bewertung_Dimmzeit()    (l_flags_RGBe_Slave_a.flags.BCM_RGBa_Bewertung_Dimmzeit_f = 0u)

/* Signal Read Access for Signal BCM_RGBa_Gueltigkeit */
#define        l_bool_rd_BCM_RGBa_Gueltigkeit()    ((l_LinData.frames.l_frm_RGBe_Slave_a.frame_data[7] >> 1u) & 1u)
#define        l_flg_tst_BCM_RGBa_Gueltigkeit()    (l_flags_RGBe_Slave_a.flags.BCM_RGBa_Gueltigkeit_f == 1u)
#define        l_flg_clr_BCM_RGBa_Gueltigkeit()    (l_flags_RGBe_Slave_a.flags.BCM_RGBa_Gueltigkeit_f = 0u)

/* Signal Read Access for Signal BCM_RGBa_Dimmzeit_Zeitbasis */
#define        l_bool_rd_BCM_RGBa_Dimmzeit_Zeitbasis()    ((l_LinData.frames.l_frm_RGBe_Slave_a.frame_data[7] >> 2u) & 1u)
#define        l_flg_tst_BCM_RGBa_Dimmzeit_Zeitbasis()    (l_flags_RGBe_Slave_a.flags.BCM_RGBa_Dimmzeit_Zeitbasis_f == 1u)
#define        l_flg_clr_BCM_RGBa_Dimmzeit_Zeitbasis()    (l_flags_RGBe_Slave_a.flags.BCM_RGBa_Dimmzeit_Zeitbasis_f = 0u)

/* Signal Write Access for Signal RGB_Slave_08a_ResponseError */
#define        l_bool_wr_RGB_Slave_08a_ResponseError(x)    do{ l_LinData.frames.l_frm_RGBs_Slave_08a.frame_data[0] &= (127u); \
                                                l_LinData.frames.l_frm_RGBs_Slave_08a.frame_data[0] |= ((l_u8)((x) << 7u)); \
                                                g_lin_frame_ctrl[1].frame.frame_type.update_flag = 1u; \
                                                }while(0)

/* Signal Write Access for Signal RGB_Slave_08a_LedRotStg */
#define        l_u8_wr_RGB_Slave_08a_LedRotStg(x)    do{ l_LinData.frames.l_frm_RGBs_Slave_08a.frame_data[1] &= (252u); \
                                                l_LinData.frames.l_frm_RGBs_Slave_08a.frame_data[1] |= ((l_u8)(x) & (0x3u)); \
                                                g_lin_frame_ctrl[1].frame.frame_type.update_flag = 1u; \
                                                }while(0)

/* Signal Write Access for Signal RGB_Slave_08a_LedGruenStg */
#define        l_u8_wr_RGB_Slave_08a_LedGruenStg(x)    do{ l_LinData.frames.l_frm_RGBs_Slave_08a.frame_data[1] &= (243u); \
                                                l_LinData.frames.l_frm_RGBs_Slave_08a.frame_data[1] |= ((l_u8)((x) << 2u) & (0xFu)); \
                                                g_lin_frame_ctrl[1].frame.frame_type.update_flag = 1u; \
                                                }while(0)

/* Signal Write Access for Signal RGB_Slave_08a_LedBlauStg */
#define        l_u8_wr_RGB_Slave_08a_LedBlauStg(x)    do{ l_LinData.frames.l_frm_RGBs_Slave_08a.frame_data[1] &= (207u); \
                                                l_LinData.frames.l_frm_RGBs_Slave_08a.frame_data[1] |= ((l_u8)((x) << 4u) & (0x3Fu)); \
                                                g_lin_frame_ctrl[1].frame.frame_type.update_flag = 1u; \
                                                }while(0)

/* Signal Write Access for Signal RGB_Slave_08a_LedRotOl */
#define        l_u8_wr_RGB_Slave_08a_LedRotOl(x)    do{ l_LinData.frames.l_frm_RGBs_Slave_08a.frame_data[1] &= (63u); \
                                                l_LinData.frames.l_frm_RGBs_Slave_08a.frame_data[1] |= ((l_u8)((x) << 6u)); \
                                                g_lin_frame_ctrl[1].frame.frame_type.update_flag = 1u; \
                                                }while(0)

/* Signal Write Access for Signal RGB_Slave_08a_LedGruenOl */
#define        l_u8_wr_RGB_Slave_08a_LedGruenOl(x)    do{ l_LinData.frames.l_frm_RGBs_Slave_08a.frame_data[2] &= (252u); \
                                                l_LinData.frames.l_frm_RGBs_Slave_08a.frame_data[2] |= ((l_u8)(x) & (0x3u)); \
                                                g_lin_frame_ctrl[1].frame.frame_type.update_flag = 1u; \
                                                }while(0)

/* Signal Write Access for Signal RGB_Slave_08a_LedBlauOl */
#define        l_u8_wr_RGB_Slave_08a_LedBlauOl(x)    do{ l_LinData.frames.l_frm_RGBs_Slave_08a.frame_data[2] &= (243u); \
                                                l_LinData.frames.l_frm_RGBs_Slave_08a.frame_data[2] |= ((l_u8)((x) << 2u) & (0xFu)); \
                                                g_lin_frame_ctrl[1].frame.frame_type.update_flag = 1u; \
                                                }while(0)

/* Signal Write Access for Signal RGB_Slave_08a_TempState */
#define        l_u8_wr_RGB_Slave_08a_TempState(x)    do{ l_LinData.frames.l_frm_RGBs_Slave_08a.frame_data[2] &= (143u); \
                                                l_LinData.frames.l_frm_RGBs_Slave_08a.frame_data[2] |= ((l_u8)((x) << 4u) & (0x7Fu)); \
                                                g_lin_frame_ctrl[1].frame.frame_type.update_flag = 1u; \
                                                }while(0)

/* Signal Write Access for Signal RGB_Slave_08a_IntErrorRam */
#define        l_u8_wr_RGB_Slave_08a_IntErrorRam(x)    do{ l_LinData.frames.l_frm_RGBs_Slave_08a.frame_data[3] &= (252u); \
                                                l_LinData.frames.l_frm_RGBs_Slave_08a.frame_data[3] |= ((l_u8)(x) & (0x3u)); \
                                                g_lin_frame_ctrl[1].frame.frame_type.update_flag = 1u; \
                                                }while(0)

/* Signal Write Access for Signal RGB_Slave_08a_IntErrorRom */
#define        l_u8_wr_RGB_Slave_08a_IntErrorRom(x)    do{ l_LinData.frames.l_frm_RGBs_Slave_08a.frame_data[3] &= (243u); \
                                                l_LinData.frames.l_frm_RGBs_Slave_08a.frame_data[3] |= ((l_u8)((x) << 2u) & (0xFu)); \
                                                g_lin_frame_ctrl[1].frame.frame_type.update_flag = 1u; \
                                                }while(0)

/* Signal Write Access for Signal RGB_Slave_08a_IntErrorNvm */
#define        l_u8_wr_RGB_Slave_08a_IntErrorNvm(x)    do{ l_LinData.frames.l_frm_RGBs_Slave_08a.frame_data[3] &= (207u); \
                                                l_LinData.frames.l_frm_RGBs_Slave_08a.frame_data[3] |= ((l_u8)((x) << 4u) & (0x3Fu)); \
                                                g_lin_frame_ctrl[1].frame.frame_type.update_flag = 1u; \
                                                }while(0)

/* LIN Driver Access to Update Signal Flags for Frame RGBe_Slave_a */
#define        l_Update_flags_frame0()    (l_flags_RGBe_Slave_a.reg[0]=(l_u16)0xFFFFu)

/* LIN Driver Access to Update Signal Flags for Frame RGBs_Slave_08a */
#define        l_Update_flags_frame1()    (l_flags_RGBs_Slave_08a.reg[0]=(l_u16)0xFFFFu)

#define        l_Update_flags_frame(x)    (l_Update_Frame_Flags((x))) 

void l_Update_Frame_Flags(l_u8 number);


/* Prototype for Byte Array Signal Access Function  */
void l_get_byte_array(l_u8 start[], l_u8  count, l_u8 destination[]);
void l_set_byte_array(l_u8 start[], l_u8  count, const l_u8 source[]);

/* Macros for Response Error Flag / Frame handling */

#define        l_Set_Response_Error_Flag()   do{ l_bool_wr_RGB_Slave_08a_ResponseError(1u); } while(0)

#define        l_Reset_Response_Error_Flag() do{ l_bool_wr_RGB_Slave_08a_ResponseError(0u); } while(0)

#define        LIN_Response_Error_Frame_PID  (g_lin_frame_ctrl[1].frame.pid)
#define        LIN_RespError_Compare_PID(x)  ((g_lin_frame_ctrl[1].frame.pid) == (x))


/* File Footer */
#endif /* end #ifndef GEN_LIN_CONFIG_H */

/* genLinConfig.h file for TLE984x */
